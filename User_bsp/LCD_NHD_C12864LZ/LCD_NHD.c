/*
 * LCD_NHD.c
 *
 *  Created on: Apr 20, 2026
 *      Author: PCBOX
 */
#include "LCD_NHD.h"

unsigned char NHD_Logo[] = {
0x00, 0x00, 0x00, 0x00, 0x00, 0x00, 0x00, 0x00, 0x00, 0x00, 0x00, 0x00, 0x00, 0x00, 0x00, 0x00,
0x00, 0x00, 0x80, 0xC0, 0xC0, 0xC0, 0x00, 0x00, 0x00, 0x00, 0x00, 0x00, 0x00, 0x00, 0x00, 0x00,
0x00, 0x00, 0x00, 0x00, 0x00, 0x00, 0x00, 0x00, 0x00, 0x00, 0x00, 0x00, 0x00, 0x00, 0x00, 0x00,
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0x00, 0x00, 0x00, 0x00, 0x00, 0x00, 0x00, 0x00, 0x00, 0x00, 0x00, 0x00, 0x00, 0x00, 0x00, 0x00
};

void comm_write(uint8_t cmd)
{
	HAL_GPIO_WritePin(LCD_CS_Port, LCD_CS_Pin, GPIO_PIN_RESET);
	HAL_GPIO_WritePin(LCD_A0_Port,LCD_A0_Pin, GPIO_PIN_RESET);

	HAL_SPI_Transmit(&hspi2, &cmd, 1, 100);

	HAL_GPIO_WritePin(LCD_CS_Port, LCD_CS_Pin, GPIO_PIN_SET);
}
void data_write(uint8_t data)
{
	HAL_GPIO_WritePin(LCD_CS_Port, LCD_CS_Pin, GPIO_PIN_RESET);
	HAL_GPIO_WritePin(LCD_A0_Port, LCD_A0_Pin, GPIO_PIN_SET);

	HAL_SPI_Transmit(&hspi2, &data, 1, 100);

	HAL_GPIO_WritePin(LCD_CS_Port, LCD_CS_Pin, GPIO_PIN_SET);
}

void  LCD_Init(void)
{
	HAL_GPIO_WritePin(LCD_PS_Port, LCD_PS_Pin, GPIO_PIN_RESET);

	HAL_GPIO_WritePin(LCD_RES_Port, LCD_RES_Pin, GPIO_PIN_RESET);
	HAL_Delay(50);

	HAL_GPIO_WritePin(LCD_RES_Port, LCD_RES_Pin, GPIO_PIN_SET);
	HAL_Delay(50);

	comm_write(0xA2);
	comm_write(0xA0);
	comm_write(0xC8);
	comm_write(0xA4);
	comm_write(0x40);
	comm_write(0x25);
	comm_write(0x81);
	comm_write(0x10);
	comm_write(0x2F);
	comm_write(0xAF);
}

void LCD_Clear(void)
{
    for(uint8_t page = 0; page < 8; page++)
    {
        comm_write(0xB0 + page);
        comm_write(0x10);
        comm_write(0x00);

        for(uint8_t col = 0; col < 128; col++)
        {
            data_write(0x00);
        }
    }
}



void LCD_Display(uint8_t *buf)
{
    for(uint8_t page = 0; page < 8; page++)
    {
        comm_write(0xB0 + page);
        comm_write(0x10);
        comm_write(0x00);

        for(uint8_t col = 0; col < 128; col++)
        {
            data_write(*buf++);
        }
    }
}


void LCD_AllPixelOn(void)
{
    comm_write(0xA5);
}

void LCD_NormalDisplay(void)
{
    comm_write(0xA4);
}

void LCD_SetContrast(uint8_t value)
{
    comm_write(0x81);
    comm_write(value);
}
void LCD_FillBlack(void)
{
    for(uint8_t page = 0; page < 8; page++)
    {
        comm_write(0xB0 + page);   // chọn page
        comm_write(0x10);          // cột cao
        comm_write(0x00);          // cột thấp

        for(uint8_t col = 0; col < 128; col++)
        {
            data_write(0xFF);      // 8 pixel đen
        }
    }
}
